## drivers/dma-buf/heaps/Kconfig
```kconfig
config DMABUF_HEAPS_SYSTEM
	bool "DMA-BUF System Heap"
	depends on DMABUF_HEAPS
	help
	  Choose this option to enable the system dmabuf heap. The system heap
	  is backed by pages from the buddy allocator. If in doubt, say Y.

config DMABUF_HEAPS_SYSTEM_DMA32
	bool "DMA-BUF System Heap: the system-dma32 and system-uncached-dma32 heaps"
	depends on DMABUF_HEAPS_SYSTEM && ZONE_DMA32
	help
	  Also register the system heap's buffers from ZONE_DMA32 under the
	  names Rockchip's 5.10/6.1 system heap used, "system-dma32" and
	  "system-uncached-dma32". A Rockchip MPP from before its dma-heap
	  name fallback (the PixelHue N-series stock encoder's) opens
	  /dev/dma_heap/system-uncached-dma32 for its default buffers and
	  fails without it. The two heaps are registered only on a board
	  whose device tree root has nova,dma-heap-dma32. Unset, the system
	  heap is unchanged.

config DMABUF_HEAPS_CMA
	bool "DMA-BUF CMA Heap"
	depends on DMABUF_HEAPS && DMA_CMA
	help
	  Choose this option to enable dma-buf CMA heap. This heap is backed
	  by the Contiguous Memory Allocator (CMA). If your system has these
	  regions, you should say Y here.

config DMABUF_HEAPS_SRAM
	tristate "Export on-chip SRAM pools using DMA-Heaps"
	depends on DMABUF_HEAPS && SRAM
	help
	  This driver allows the export of on-chip SRAM marked as exportable
	  to userspace using the DMA-Heaps interface.
```

## drivers/gpu/drm/bridge/synopsys/Kconfig
```kconfig
# SPDX-License-Identifier: GPL-2.0-only
config DRM_DW_HDMI
	tristate
	select DRM_DISPLAY_HDMI_HELPER
	select DRM_DISPLAY_HELPER
	select DRM_KMS_HELPER
	select REGMAP_MMIO
	select CEC_CORE if CEC_NOTIFIER

config DRM_DW_HDMI_NOVA_VSERIES
	bool "NovaStar V-series vendor HDMI mode list (drm_mode= bootarg)"
	depends on DRM_DW_HDMI=y
	help
	  The NovaStar V-series stock kernel's dw-hdmi, on a board whose HDMI
	  device-tree node has the nova,vendor-drm-mode property: the drm_mode=
	  timing U-Boot passes becomes the connector's preferred mode, the
	  connector reports the vendor's fixed mode tables instead of the
	  EDID's, and the EDID only decides the HDMI/DVI bit of FC_INVIDCONF.
	  A board without the property keeps the stock driver. Built in only
	  (drm_mode= is a __setup handler). Say N unless building NovaOS for a
	  V-series unit.

config DRM_DW_HDMI_AHB_AUDIO
	tristate "Synopsys Designware AHB Audio interface"
	depends on DRM_DW_HDMI && SND
	select SND_PCM
	select SND_PCM_ELD
	select SND_PCM_IEC958
	help
	  Support the AHB Audio interface which is part of the Synopsys
	  Designware HDMI block.  This is used in conjunction with
	  the i.MX6 HDMI driver.

config DRM_DW_HDMI_I2S_AUDIO
	tristate "Synopsys Designware I2S Audio interface"
	depends on SND_SOC
	depends on DRM_DW_HDMI
	select SND_SOC_HDMI_CODEC
	help
	  Support the I2S Audio interface which is part of the Synopsys
	  Designware HDMI block.

config DRM_DW_HDMI_GP_AUDIO
	tristate "Synopsys Designware GP Audio interface"
	depends on DRM_DW_HDMI && SND
	select SND_PCM
	select SND_PCM_ELD
	select SND_PCM_IEC958
	help
	  Support the GP Audio interface which is part of the Synopsys
	  Designware HDMI block.

config DRM_DW_HDMI_CEC
	tristate "Synopsis Designware CEC interface"
	depends on DRM_DW_HDMI
	select CEC_CORE
	select CEC_NOTIFIER
	help
	  Support the CE interface which is part of the Synopsys
	  Designware HDMI block.

config DRM_DW_MIPI_DSI
	tristate
	select DRM_KMS_HELPER
	select DRM_MIPI_DSI
	select DRM_PANEL_BRIDGE
```
